/*
 * GccApplication5.c
 *
 * Created: 15.01.07 17:52:05 
 *  Author: Administrator
 */ 

//#define STACK_SIZE 112640 

#include <sam4e8c.h>
#include <fastmath.h>

#define IOPORT_PIOD     3
#define IOPORT_CREATE_PIN(port, pin) ((IOPORT_ ## port) * 32 + (pin))
#define LED_0_PIN    IOPORT_CREATE_PIN(PIOD, 24)
/**
 * \brief Application entry point.
 *
 * \return Unused (ANSI-C compatibility).
 */

typedef unsigned char uchar;
uchar video_H[1000] = {5,5,5,5,5,5,5,5,5,5,5,5,5,5,5};
//uchar video_L[31000] = {5,5,5,5,5,5,5,5,5,5,5,5,5,5,5};
#include "header.h"

Pio* base;
Uart* pf_uart;
uint32_t mask;
TcChannel *tc_channel;

unsigned char c = 0;

uint8_t buffer[31000];
uint8_t buffer_usart[20] = {55};

static int incr = 0;

int main(void)
{
	/* Initialize the SAM system */
	SystemInit();
	
	PMC->PMC_PCER0 = 1 << ID_PIOD;
	base = (Pio *)(uintptr_t)PIOD;
	mask = 1U << (LED_0_PIN & 0x1F);
	base->PIO_OER = mask;
	//base->PIO_MDER = mask;
	//base->PIO_PUER = mask;
	
	
	PMC->PMC_PCER0 = 1 << ID_PIOA;
	PIOA->PIO_OER = 1<<9 | 1<<10 | 0b1111111111<<16;
	PMC->PMC_PCER0 = 1 << ID_PIOB;
	PIOB->PIO_OER = 0b11111111;
	
	
	
	PMC->PMC_PCER0 = 1 << ID_TC0;
	tc_channel = TC0->TC_CHANNEL + 0;//TC0->TC_CHANNEL[0]
	tc_channel->TC_CCR = TC_CCR_CLKDIS;
	tc_channel->TC_IDR = 0xFFFFFFFF;
	tc_channel->TC_SR;
	tc_channel->TC_CMR = 0 | TC_CMR_CPCTRG;
	tc_channel->TC_IER = TC_IER_CPCS;
	tc_channel->TC_RC = 4687;
	tc_channel->TC_CCR = TC_CCR_CLKEN | TC_CCR_SWTRG;
	
	
	

	
	
	
	
	
	Pio* uartbase = (Pio *)(uintptr_t)PIOA;
	uint32_t ul_mask = PIO_PA10A_UTXD0 | PIO_PA9A_URXD0;
	uartbase->PIO_PDR = ul_mask;
	uartbase->PIO_IDR = ul_mask;
	uint32_t ul_sr = uartbase->PIO_ABCDSR[0];
	uartbase->PIO_ABCDSR[0] &= (~ul_mask & ul_sr);
	ul_sr = uartbase->PIO_ABCDSR[1];
	uartbase->PIO_ABCDSR[1] &= (~ul_mask & ul_sr);

	PMC->PMC_PCER0 = (1 << ID_UART0);
	pf_uart = (Uart*)(uintptr_t)UART0;
	pf_uart->UART_CR = UART_CR_RSTRX | UART_CR_RSTTX | UART_CR_RXDIS | UART_CR_TXDIS;
	pf_uart->UART_BRGR = 2;
	pf_uart->UART_MR = UART_MR_PAR_NO;
	pf_uart->UART_PTCR = UART_PTCR_RXTDIS | UART_PTCR_TXTDIS;
	pf_uart->UART_CR = UART_CR_RXEN | UART_CR_TXEN;
	
	
	Pdc* uart = (Pdc *)(uintptr_t)PDC_UART0;
	uart->PERIPH_RPR = (uint32_t)buffer;
	uart->PERIPH_RCR = 200;
	uart->PERIPH_PTCR = PERIPH_PTCR_RXTEN | PERIPH_PTCR_TXTEN;
	pf_uart->UART_IER = UART_IER_RXBUFF;
	
	
	
	
	
	
	
	
	
	
	
	Pio* usartbase = (Pio *)(uintptr_t)PIOB;
	uint32_t ul2_mask = PIO_PB1C_TXD0;
	usartbase->PIO_PDR = ul2_mask;
	usartbase->PIO_IDR = ul2_mask;
	uint32_t ul_sr2 = usartbase->PIO_ABCDSR[0];
	usartbase->PIO_ABCDSR[0] &= (~ul_mask & ul_sr2);
	ul_sr2 = usartbase->PIO_ABCDSR[1];
	usartbase->PIO_ABCDSR[1] &= (~ul_mask & ul_sr2);
	
	PMC->PMC_PCER0 = (1 << ID_USART0);
	Usart* pf_usart = (Usart*)(uintptr_t)USART0;
	pf_usart->US_WPMR = US_WPMR_WPKEY_PASSWD;
	pf_usart->US_MR = 0;
	pf_usart->US_RTOR = 0;
	pf_usart->US_TTGR = 0;
	pf_usart->US_CR = US_CR_RSTTX | US_CR_TXDIS;
	pf_usart->US_CR = US_CR_RSTRX | US_CR_RXDIS;
	pf_usart->US_CR = US_CR_RSTSTA;
	pf_usart->US_CR = US_CR_RTSDIS;
	pf_usart->US_CR = US_CR_DTRDIS;
	//pf_usart->US_MR |= US_MR_OVER; //8x
	pf_usart->US_BRGR = (2 << US_BRGR_CD_Pos) | (0 << US_BRGR_FP_Pos);
	pf_usart->US_MR |= US_MR_CHRL_8_BIT | US_MR_PAR_NO | US_MR_CHMODE_NORMAL | US_MR_NBSTOP_1_BIT;
	pf_usart->US_IDR = 0xffffffff;
	pf_usart->US_CR = US_CR_TXEN;
	pf_usart->US_CR = US_CR_RXEN;
	
	Pdc* usart = (Pdc *)(uintptr_t)PDC_USART0;
	usart->PERIPH_PTCR = PERIPH_PTCR_RXTEN | PERIPH_PTCR_TXTEN;
	usart->PERIPH_TPR = (uint32_t)buffer_usart;
	usart->PERIPH_TCR = 20;
	pf_usart->US_IER = US_IER_TXBUFE;










	NVIC_DisableIRQ(ID_TC0);
	NVIC_DisableIRQ(UART0_IRQn);
	NVIC_DisableIRQ(USART0_IRQn);
	NVIC_ClearPendingIRQ(ID_TC0);
	NVIC_SetPriority(ID_TC0,2);
	NVIC_ClearPendingIRQ(UART0_IRQn);
	NVIC_SetPriority(UART0_IRQn,1);
	NVIC_ClearPendingIRQ(USART0_IRQn);
	NVIC_SetPriority(USART0_IRQn,0);
	//NVIC_EnableIRQ(ID_TC0);
	NVIC_EnableIRQ(UART0_IRQn);
	//NVIC_EnableIRQ(USART0_IRQn);
	short num = 0;
	char even = 0;
	int a = 0;
	while (1)
	{
		//while (!(UART0->UART_SR & UART_SR_TXRDY));
		//pf_uart->UART_THR = 'z';
		//while(!(UART0->UART_SR & UART_SR_RXRDY));
		//pf_uart->UART_THR = (uint8_t) pf_uart->UART_RHR;
		
		
		//for(int i = 0; i < 100; ++i){
		//	array[i] *= 10;
		//	array[99-i] = i;
		//	array[i] = array[i]*array[99-i];
		//}
		
		
		
		
		//base->PIO_CODR = mask;
		//float f = sin(0.5f);
		//char a = array[0];
		//even = !even;
		//++a;
		//a = a%100;
		//if(even){
		base->PIO_SODR = mask;
			//base->PIO_OER = mask;
			//base->PIO_SODR = mask;
			//base->PIO_SODR = mask;
			asm("nop");
			asm("nop");
			asm("nop");
			asm("nop");
			asm("nop");
			asm("nop");
			asm("nop");
			asm("nop");
			asm("nop");
			asm("nop");
			asm("nop");
			asm("nop");
			asm("nop");
			asm("nop");
			asm("nop");
			asm("nop");
			asm("nop");

		//}
		//else {
		base->PIO_CODR = mask;
			//base->PIO_ODR = mask;
			//base->PIO_CODR = mask;
			//base->PIO_CODR = mask;
			asm("nop");
			asm("nop");
			asm("nop");
			asm("nop");
			asm("nop");
			asm("nop");
			asm("nop");
			asm("nop");
			asm("nop");
			asm("nop");
			asm("nop");
			asm("nop");
			asm("nop");
			asm("nop");
			asm("nop");


		//}

		//++num;
		//num %= 512;
		
		//short C;
		//short D;
		//short E;
		//
		//incr = 0;
		////256 everywhere + *3!
		////green = 225
		////max 2ma???
		//PIOB->PIO_CODR = 15;
		//PIOB->PIO_SODR = 1;
		//C = video_H[indexes[num][incr++]] - 16;
		//D = video_H[indexes[num][incr++]] - 128;
		//E = video_H[indexes[num][incr++]] - 128;
		//PIOB->PIO_CODR = 15<<4;
		//PIOB->PIO_SODR = 1<<4;
		//PIOA->PIO_CODR = 0b1111111111<<16;
		//PIOA->PIO_SODR = (205+( 298 * C           + 409 * E + 128))<<16;
		//PIOB->PIO_CODR = 15<<4;
		//PIOB->PIO_SODR = 1<<4;
		//PIOA->PIO_CODR = 0b1111111111<<16;
		//PIOA->PIO_SODR = (205+( 298 * C - 100 * D - 208 * E + 128))<<16;
		//PIOB->PIO_CODR = 15<<4;
		//PIOB->PIO_SODR = 1<<4;
		//PIOA->PIO_CODR = 0b1111111111<<16;
		//PIOA->PIO_SODR = (205+( 298 * C + 516 * D           + 128))<<16;
		//PIOA->PIO_CODR = 0b1111111111<<16;
		//PIOB->PIO_CODR = 15;
		//PIOB->PIO_SODR = 1;
		//C = video_H[indexes[num][incr++]] - 16;
		//D = video_H[indexes[num][incr++]] - 128;
		//E = video_H[indexes[num][incr++]] - 128;
		//PIOB->PIO_CODR = 15<<4;
		//PIOB->PIO_SODR = 1<<4;
		//PIOA->PIO_CODR = 0b1111111111<<16;
		//PIOA->PIO_SODR = (205+( 298 * C           + 409 * E + 128))<<16;
		//PIOB->PIO_CODR = 15<<4;
		//PIOB->PIO_SODR = 1<<4;
		//PIOA->PIO_CODR = 0b1111111111<<16;
		//PIOA->PIO_SODR = (205+( 298 * C - 100 * D - 208 * E + 128))<<16;
		//PIOB->PIO_CODR = 15<<4;
		//PIOB->PIO_SODR = 1<<4;
		//PIOA->PIO_CODR = 0b1111111111<<16;
		//PIOA->PIO_SODR = (205+( 298 * C + 516 * D           + 128))<<16;
		//PIOA->PIO_CODR = 0b1111111111<<16;
		//PIOB->PIO_CODR = 15;
		//PIOB->PIO_SODR = 1;
		//C = video_H[indexes[num][incr++]] - 16;
		//D = video_H[indexes[num][incr++]] - 128;
		//E = video_H[indexes[num][incr++]] - 128;
		//PIOB->PIO_CODR = 15<<4;
		//PIOB->PIO_SODR = 1<<4;
		//PIOA->PIO_CODR = 0b1111111111<<16;
		//PIOA->PIO_SODR = (205+( 298 * C           + 409 * E + 128))<<16;
		//PIOB->PIO_CODR = 15<<4;
		//PIOB->PIO_SODR = 1<<4;
		//PIOA->PIO_CODR = 0b1111111111<<16;
		//PIOA->PIO_SODR = (205+( 298 * C - 100 * D - 208 * E + 128))<<16;
		//PIOB->PIO_CODR = 15<<4;
		//PIOB->PIO_SODR = 1<<4;
		//PIOA->PIO_CODR = 0b1111111111<<16;
		//PIOA->PIO_SODR = (205+( 298 * C + 516 * D           + 128))<<16;
		//PIOA->PIO_CODR = 0b1111111111<<16;
		//PIOB->PIO_CODR = 15;
		//PIOB->PIO_SODR = 1;
		//C = video_H[indexes[num][incr++]] - 16;
		//D = video_H[indexes[num][incr++]] - 128;
		//E = video_H[indexes[num][incr++]] - 128;
		//PIOB->PIO_CODR = 15<<4;
		//PIOB->PIO_SODR = 1<<4;
		//PIOA->PIO_CODR = 0b1111111111<<16;
		//PIOA->PIO_SODR = (205+( 298 * C           + 409 * E + 128))<<16;
		//PIOB->PIO_CODR = 15<<4;
		//PIOB->PIO_SODR = 1<<4;
		//PIOA->PIO_CODR = 0b1111111111<<16;
		//PIOA->PIO_SODR = (205+( 298 * C - 100 * D - 208 * E + 128))<<16;
		//PIOB->PIO_CODR = 15<<4;
		//PIOB->PIO_SODR = 1<<4;
		//PIOA->PIO_CODR = 0b1111111111<<16;
		//PIOA->PIO_SODR = (205+( 298 * C + 516 * D           + 128))<<16;
		//PIOA->PIO_CODR = 0b1111111111<<16;
		//PIOB->PIO_CODR = 15;
		//PIOB->PIO_SODR = 1;
		//C = video_H[indexes[num][incr++]] - 16;
		//D = video_H[indexes[num][incr++]] - 128;
		//E = video_H[indexes[num][incr++]] - 128;
		//PIOB->PIO_CODR = 15<<4;
		//PIOB->PIO_SODR = 1<<4;
		//PIOA->PIO_CODR = 0b1111111111<<16;
		//PIOA->PIO_SODR = (205+( 298 * C           + 409 * E + 128))<<16;
		//PIOB->PIO_CODR = 15<<4;
		//PIOB->PIO_SODR = 1<<4;
		//PIOA->PIO_CODR = 0b1111111111<<16;
		//PIOA->PIO_SODR = (205+( 298 * C - 100 * D - 208 * E + 128))<<16;
		//PIOB->PIO_CODR = 15<<4;
		//PIOB->PIO_SODR = 1<<4;
		//PIOA->PIO_CODR = 0b1111111111<<16;
		//PIOA->PIO_SODR = (205+( 298 * C + 516 * D           + 128))<<16;
		//PIOA->PIO_CODR = 0b1111111111<<16;
		//
		//PIOB->PIO_CODR = 15;
		//PIOB->PIO_SODR = 1;
		//C = video_H[indexes[num][incr++]] - 16;
		//D = video_H[indexes[num][incr++]] - 128;
		//E = video_H[indexes[num][incr++]] - 128;
		//PIOB->PIO_CODR = 15<<4;
		//PIOB->PIO_SODR = 1<<4;
		//PIOA->PIO_CODR = 0b1111111111<<16;
		//PIOA->PIO_SODR = (205+( 298 * C           + 409 * E + 128))<<16;
		//PIOB->PIO_CODR = 15<<4;
		//PIOB->PIO_SODR = 1<<4;
		//PIOA->PIO_CODR = 0b1111111111<<16;
		//PIOA->PIO_SODR = (205+( 298 * C - 100 * D - 208 * E + 128))<<16;
		//PIOB->PIO_CODR = 15<<4;
		//PIOB->PIO_SODR = 1<<4;
		//PIOA->PIO_CODR = 0b1111111111<<16;
		//PIOA->PIO_SODR = (205+( 298 * C + 516 * D           + 128))<<16;
		//PIOA->PIO_CODR = 0b1111111111<<16;
		//PIOB->PIO_CODR = 15;
		//PIOB->PIO_SODR = 1;
		//C = video_H[indexes[num][incr++]] - 16;
		//D = video_H[indexes[num][incr++]] - 128;
		//E = video_H[indexes[num][incr++]] - 128;
		//PIOB->PIO_CODR = 15<<4;
		//PIOB->PIO_SODR = 1<<4;
		//PIOA->PIO_CODR = 0b1111111111<<16;
		//PIOA->PIO_SODR = (205+( 298 * C           + 409 * E + 128))<<16;
		//PIOB->PIO_CODR = 15<<4;
		//PIOB->PIO_SODR = 1<<4;
		//PIOA->PIO_CODR = 0b1111111111<<16;
		//PIOA->PIO_SODR = (205+( 298 * C - 100 * D - 208 * E + 128))<<16;
		//PIOB->PIO_CODR = 15<<4;
		//PIOB->PIO_SODR = 1<<4;
		//PIOA->PIO_CODR = 0b1111111111<<16;
		//PIOA->PIO_SODR = (205+( 298 * C + 516 * D           + 128))<<16;
		//PIOA->PIO_CODR = 0b1111111111<<16;
		//PIOB->PIO_CODR = 15;
		//PIOB->PIO_SODR = 1;
		//C = video_H[indexes[num][incr++]] - 16;
		//D = video_H[indexes[num][incr++]] - 128;
		//E = video_H[indexes[num][incr++]] - 128;
		//PIOB->PIO_CODR = 15<<4;
		//PIOB->PIO_SODR = 1<<4;
		//PIOA->PIO_CODR = 0b1111111111<<16;
		//PIOA->PIO_SODR = (205+( 298 * C           + 409 * E + 128))<<16;
		//PIOB->PIO_CODR = 15<<4;
		//PIOB->PIO_SODR = 1<<4;
		//PIOA->PIO_CODR = 0b1111111111<<16;
		//PIOA->PIO_SODR = (205+( 298 * C - 100 * D - 208 * E + 128))<<16;
		//PIOB->PIO_CODR = 15<<4;
		//PIOB->PIO_SODR = 1<<4;
		//PIOA->PIO_CODR = 0b1111111111<<16;
		//PIOA->PIO_SODR = (205+( 298 * C + 516 * D           + 128))<<16;
		//PIOA->PIO_CODR = 0b1111111111<<16;
		//PIOB->PIO_CODR = 15;
		//PIOB->PIO_SODR = 1;
		//C = video_H[indexes[num][incr++]] - 16;
		//D = video_H[indexes[num][incr++]] - 128;
		//E = video_H[indexes[num][incr++]] - 128;
		//PIOB->PIO_CODR = 15<<4;
		//PIOB->PIO_SODR = 1<<4;
		//PIOA->PIO_CODR = 0b1111111111<<16;
		//PIOA->PIO_SODR = (205+( 298 * C           + 409 * E + 128))<<16;
		//PIOB->PIO_CODR = 15<<4;
		//PIOB->PIO_SODR = 1<<4;
		//PIOA->PIO_CODR = 0b1111111111<<16;
		//PIOA->PIO_SODR = (205+( 298 * C - 100 * D - 208 * E + 128))<<16;
		//PIOB->PIO_CODR = 15<<4;
		//PIOB->PIO_SODR = 1<<4;
		//PIOA->PIO_CODR = 0b1111111111<<16;
		//PIOA->PIO_SODR = (205+( 298 * C + 516 * D           + 128))<<16;
		//PIOA->PIO_CODR = 0b1111111111<<16;
		//PIOB->PIO_CODR = 15;
		//PIOB->PIO_SODR = 1;
		//C = video_H[indexes[num][incr++]] - 16;
		//D = video_H[indexes[num][incr++]] - 128;
		//E = video_H[indexes[num][incr++]] - 128;
		//PIOB->PIO_CODR = 15<<4;
		//PIOB->PIO_SODR = 1<<4;
		//PIOA->PIO_CODR = 0b1111111111<<16;
		//PIOA->PIO_SODR = (205+( 298 * C           + 409 * E + 128))<<16;
		//PIOB->PIO_CODR = 15<<4;
		//PIOB->PIO_SODR = 1<<4;
		//PIOA->PIO_CODR = 0b1111111111<<16;
		//PIOA->PIO_SODR = (205+( 298 * C - 100 * D - 208 * E + 128))<<16;
		//PIOB->PIO_CODR = 15<<4;
		//PIOB->PIO_SODR = 1<<4;
		//PIOA->PIO_CODR = 0b1111111111<<16;
		//PIOA->PIO_SODR = (205+( 298 * C + 516 * D           + 128))<<16;
		//PIOA->PIO_CODR = 0b1111111111<<16;
		//
		//PIOB->PIO_CODR = 15;
		//PIOB->PIO_SODR = 1;
		//C = video_H[indexes[num][incr++]] - 16;
		//D = video_H[indexes[num][incr++]] - 128;
		//E = video_H[indexes[num][incr++]] - 128;
		//PIOB->PIO_CODR = 15<<4;
		//PIOB->PIO_SODR = 1<<4;
		//PIOA->PIO_CODR = 0b1111111111<<16;
		//PIOA->PIO_SODR = (205+( 298 * C           + 409 * E + 128))<<16;
		//PIOB->PIO_CODR = 15<<4;
		//PIOB->PIO_SODR = 1<<4;
		//PIOA->PIO_CODR = 0b1111111111<<16;
		//PIOA->PIO_SODR = (205+( 298 * C - 100 * D - 208 * E + 128))<<16;
		//PIOB->PIO_CODR = 15<<4;
		//PIOB->PIO_SODR = 1<<4;
		//PIOA->PIO_CODR = 0b1111111111<<16;
		//PIOA->PIO_SODR = (205+( 298 * C + 516 * D           + 128))<<16;
		//PIOA->PIO_CODR = 0b1111111111<<16;
		//PIOB->PIO_CODR = 15;
		//PIOB->PIO_SODR = 1;
		//C = video_H[indexes[num][incr++]] - 16;
		//D = video_H[indexes[num][incr++]] - 128;
		//E = video_H[indexes[num][incr++]] - 128;
		//PIOB->PIO_CODR = 15<<4;
		//PIOB->PIO_SODR = 1<<4;
		//PIOA->PIO_CODR = 0b1111111111<<16;
		//PIOA->PIO_SODR = (205+( 298 * C           + 409 * E + 128))<<16;
		//PIOB->PIO_CODR = 15<<4;
		//PIOB->PIO_SODR = 1<<4;
		//PIOA->PIO_CODR = 0b1111111111<<16;
		//PIOA->PIO_SODR = (205+( 298 * C - 100 * D - 208 * E + 128))<<16;
		//PIOB->PIO_CODR = 15<<4;
		//PIOB->PIO_SODR = 1<<4;
		//PIOA->PIO_CODR = 0b1111111111<<16;
		//PIOA->PIO_SODR = (205+( 298 * C + 516 * D           + 128))<<16;
		//PIOA->PIO_CODR = 0b1111111111<<16;
		//PIOB->PIO_CODR = 15;
		//PIOB->PIO_SODR = 1;
		//C = video_H[indexes[num][incr++]] - 16;
		//D = video_H[indexes[num][incr++]] - 128;
		//E = video_H[indexes[num][incr++]] - 128;
		//PIOB->PIO_CODR = 15<<4;
		//PIOB->PIO_SODR = 1<<4;
		//PIOA->PIO_CODR = 0b1111111111<<16;
		//PIOA->PIO_SODR = (205+( 298 * C           + 409 * E + 128))<<16;
		//PIOB->PIO_CODR = 15<<4;
		//PIOB->PIO_SODR = 1<<4;
		//PIOA->PIO_CODR = 0b1111111111<<16;
		//PIOA->PIO_SODR = (205+( 298 * C - 100 * D - 208 * E + 128))<<16;
		//PIOB->PIO_CODR = 15<<4;
		//PIOB->PIO_SODR = 1<<4;
		//PIOA->PIO_CODR = 0b1111111111<<16;
		//PIOA->PIO_SODR = (205+( 298 * C + 516 * D           + 128))<<16;
		//PIOA->PIO_CODR = 0b1111111111<<16;
		//PIOB->PIO_CODR = 15;
		//PIOB->PIO_SODR = 1;
		//C = video_H[indexes[num][incr++]] - 16;
		//D = video_H[indexes[num][incr++]] - 128;
		//E = video_H[indexes[num][incr++]] - 128;
		//PIOB->PIO_CODR = 15<<4;
		//PIOB->PIO_SODR = 1<<4;
		//PIOA->PIO_CODR = 0b1111111111<<16;
		//PIOA->PIO_SODR = (205+( 298 * C           + 409 * E + 128))<<16;
		//PIOB->PIO_CODR = 15<<4;
		//PIOB->PIO_SODR = 1<<4;
		//PIOA->PIO_CODR = 0b1111111111<<16;
		//PIOA->PIO_SODR = (205+( 298 * C - 100 * D - 208 * E + 128))<<16;
		//PIOB->PIO_CODR = 15<<4;
		//PIOB->PIO_SODR = 1<<4;
		//PIOA->PIO_CODR = 0b1111111111<<16;
		//PIOA->PIO_SODR = (205+( 298 * C + 516 * D           + 128))<<16;
		//PIOA->PIO_CODR = 0b1111111111<<16;
		//PIOB->PIO_CODR = 15;
		//PIOB->PIO_SODR = 1;
		//C = video_H[indexes[num][incr++]] - 16;
		//D = video_H[indexes[num][incr++]] - 128;
		//E = video_H[indexes[num][incr++]] - 128;
		//PIOB->PIO_CODR = 15<<4;
		//PIOB->PIO_SODR = 1<<4;
		//PIOA->PIO_CODR = 0b1111111111<<16;
		//PIOA->PIO_SODR = (205+( 298 * C           + 409 * E + 128))<<16;
		//PIOB->PIO_CODR = 15<<4;
		//PIOB->PIO_SODR = 1<<4;
		//PIOA->PIO_CODR = 0b1111111111<<16;
		//PIOA->PIO_SODR = (205+( 298 * C - 100 * D - 208 * E + 128))<<16;
		//PIOB->PIO_CODR = 15<<4;
		//PIOB->PIO_SODR = 1<<4;
		//PIOA->PIO_CODR = 0b1111111111<<16;
		//PIOA->PIO_SODR = (205+( 298 * C + 516 * D           + 128))<<16;
		//PIOA->PIO_CODR = 0b1111111111<<16;
		//
		//PIOB->PIO_CODR = 15;
		//PIOB->PIO_SODR = 1;
		//C = video_H[indexes[num][incr++]] - 16;
		//D = video_H[indexes[num][incr++]] - 128;
		//E = video_H[indexes[num][incr++]] - 128;
		//PIOB->PIO_CODR = 15<<4;
		//PIOB->PIO_SODR = 1<<4;
		//PIOA->PIO_CODR = 0b1111111111<<16;
		//PIOA->PIO_SODR = (205+( 298 * C           + 409 * E + 128))<<16;
		//PIOB->PIO_CODR = 15<<4;
		//PIOB->PIO_SODR = 1<<4;
		//PIOA->PIO_CODR = 0b1111111111<<16;
		//PIOA->PIO_SODR = (205+( 298 * C - 100 * D - 208 * E + 128))<<16;
		//PIOB->PIO_CODR = 15<<4;
		//PIOB->PIO_SODR = 1<<4;
		//PIOA->PIO_CODR = 0b1111111111<<16;
		//PIOA->PIO_SODR = (205+( 298 * C + 516 * D           + 128))<<16;
		//PIOA->PIO_CODR = 0b1111111111<<16;
		//PIOB->PIO_CODR = 15;
		//PIOB->PIO_SODR = 1;
		//C = video_H[indexes[num][incr++]] - 16;
		//D = video_H[indexes[num][incr++]] - 128;
		//E = video_H[indexes[num][incr++]] - 128;
		//PIOB->PIO_CODR = 15<<4;
		//PIOB->PIO_SODR = 1<<4;
		//PIOA->PIO_CODR = 0b1111111111<<16;
		//PIOA->PIO_SODR = (205+( 298 * C           + 409 * E + 128))<<16;
		//PIOB->PIO_CODR = 15<<4;
		//PIOB->PIO_SODR = 1<<4;
		//PIOA->PIO_CODR = 0b1111111111<<16;
		//PIOA->PIO_SODR = (205+( 298 * C - 100 * D - 208 * E + 128))<<16;
		//PIOB->PIO_CODR = 15<<4;
		//PIOB->PIO_SODR = 1<<4;
		//PIOA->PIO_CODR = 0b1111111111<<16;
		//PIOA->PIO_SODR = (205+( 298 * C + 516 * D           + 128))<<16;
		//PIOA->PIO_CODR = 0b1111111111<<16;
		//PIOB->PIO_CODR = 15;
		//PIOB->PIO_SODR = 1;
		//C = video_H[indexes[num][incr++]] - 16;
		//D = video_H[indexes[num][incr++]] - 128;
		//E = video_H[indexes[num][incr++]] - 128;
		//PIOB->PIO_CODR = 15<<4;
		//PIOB->PIO_SODR = 1<<4;
		//PIOA->PIO_CODR = 0b1111111111<<16;
		//PIOA->PIO_SODR = (205+( 298 * C           + 409 * E + 128))<<16;
		//PIOB->PIO_CODR = 15<<4;
		//PIOB->PIO_SODR = 1<<4;
		//PIOA->PIO_CODR = 0b1111111111<<16;
		//PIOA->PIO_SODR = (205+( 298 * C - 100 * D - 208 * E + 128))<<16;
		//PIOB->PIO_CODR = 15<<4;
		//PIOB->PIO_SODR = 1<<4;
		//PIOA->PIO_CODR = 0b1111111111<<16;
		//PIOA->PIO_SODR = (205+( 298 * C + 516 * D           + 128))<<16;
		//PIOA->PIO_CODR = 0b1111111111<<16;
		//PIOB->PIO_CODR = 15;
		//PIOB->PIO_SODR = 1;
		//C = video_H[indexes[num][incr++]] - 16;
		//D = video_H[indexes[num][incr++]] - 128;
		//E = video_H[indexes[num][incr++]] - 128;
		//PIOB->PIO_CODR = 15<<4;
		//PIOB->PIO_SODR = 1<<4;
		//PIOA->PIO_CODR = 0b1111111111<<16;
		//PIOA->PIO_SODR = (205+( 298 * C           + 409 * E + 128))<<16;
		//PIOB->PIO_CODR = 15<<4;
		//PIOB->PIO_SODR = 1<<4;
		//PIOA->PIO_CODR = 0b1111111111<<16;
		//PIOA->PIO_SODR = (205+( 298 * C - 100 * D - 208 * E + 128))<<16;
		//PIOB->PIO_CODR = 15<<4;
		//PIOB->PIO_SODR = 1<<4;
		//PIOA->PIO_CODR = 0b1111111111<<16;
		//PIOA->PIO_SODR = (205+( 298 * C + 516 * D           + 128))<<16;
		//PIOA->PIO_CODR = 0b1111111111<<16;
		//PIOB->PIO_CODR = 15;
		//PIOB->PIO_SODR = 1;
		//C = video_H[indexes[num][incr++]] - 16;
		//D = video_H[indexes[num][incr++]] - 128;
		//E = video_H[indexes[num][incr++]] - 128;
		//PIOB->PIO_CODR = 15<<4;
		//PIOB->PIO_SODR = 1<<4;
		//PIOA->PIO_CODR = 0b1111111111<<16;
		//PIOA->PIO_SODR = (205+( 298 * C           + 409 * E + 128))<<16;
		//PIOB->PIO_CODR = 15<<4;
		//PIOB->PIO_SODR = 1<<4;
		//PIOA->PIO_CODR = 0b1111111111<<16;
		//PIOA->PIO_SODR = (205+( 298 * C - 100 * D - 208 * E + 128))<<16;
		//PIOB->PIO_CODR = 15<<4;
		//PIOB->PIO_SODR = 1<<4;
		//PIOA->PIO_CODR = 0b1111111111<<16;
		//PIOA->PIO_SODR = (205+( 298 * C + 516 * D           + 128))<<16;
		//PIOA->PIO_CODR = 0b1111111111<<16;
		//
		//PIOB->PIO_CODR = 15;
		//PIOB->PIO_SODR = 1;
		//C = video_H[indexes[num][incr++]] - 16;
		//D = video_H[indexes[num][incr++]] - 128;
		//E = video_H[indexes[num][incr++]] - 128;
		//PIOB->PIO_CODR = 15<<4;
		//PIOB->PIO_SODR = 1<<4;
		//PIOA->PIO_CODR = 0b1111111111<<16;
		//PIOA->PIO_SODR = (205+( 298 * C           + 409 * E + 128))<<16;
		//PIOB->PIO_CODR = 15<<4;
		//PIOB->PIO_SODR = 1<<4;
		//PIOA->PIO_CODR = 0b1111111111<<16;
		//PIOA->PIO_SODR = (205+( 298 * C - 100 * D - 208 * E + 128))<<16;
		//PIOB->PIO_CODR = 15<<4;
		//PIOB->PIO_SODR = 1<<4;
		//PIOA->PIO_CODR = 0b1111111111<<16;
		//PIOA->PIO_SODR = (205+( 298 * C + 516 * D           + 128))<<16;
		//PIOA->PIO_CODR = 0b1111111111<<16;
		//PIOB->PIO_CODR = 15;
		//PIOB->PIO_SODR = 1;
		//C = video_H[indexes[num][incr++]] - 16;
		//D = video_H[indexes[num][incr++]] - 128;
		//E = video_H[indexes[num][incr++]] - 128;
		//PIOB->PIO_CODR = 15<<4;
		//PIOB->PIO_SODR = 1<<4;
		//PIOA->PIO_CODR = 0b1111111111<<16;
		//PIOA->PIO_SODR = (205+( 298 * C           + 409 * E + 128))<<16;
		//PIOB->PIO_CODR = 15<<4;
		//PIOB->PIO_SODR = 1<<4;
		//PIOA->PIO_CODR = 0b1111111111<<16;
		//PIOA->PIO_SODR = (205+( 298 * C - 100 * D - 208 * E + 128))<<16;
		//PIOB->PIO_CODR = 15<<4;
		//PIOB->PIO_SODR = 1<<4;
		//PIOA->PIO_CODR = 0b1111111111<<16;
		//PIOA->PIO_SODR = (205+( 298 * C + 516 * D           + 128))<<16;
		//PIOA->PIO_CODR = 0b1111111111<<16;
		//PIOB->PIO_CODR = 15;
		//PIOB->PIO_SODR = 1;
		//C = video_H[indexes[num][incr++]] - 16;
		//D = video_H[indexes[num][incr++]] - 128;
		//E = video_H[indexes[num][incr++]] - 128;
		//PIOB->PIO_CODR = 15<<4;
		//PIOB->PIO_SODR = 1<<4;
		//PIOA->PIO_CODR = 0b1111111111<<16;
		//PIOA->PIO_SODR = (205+( 298 * C           + 409 * E + 128))<<16;
		//PIOB->PIO_CODR = 15<<4;
		//PIOB->PIO_SODR = 1<<4;
		//PIOA->PIO_CODR = 0b1111111111<<16;
		//PIOA->PIO_SODR = (205+( 298 * C - 100 * D - 208 * E + 128))<<16;
		//PIOB->PIO_CODR = 15<<4;
		//PIOB->PIO_SODR = 1<<4;
		//PIOA->PIO_CODR = 0b1111111111<<16;
		//PIOA->PIO_SODR = (205+( 298 * C + 516 * D           + 128))<<16;
		//PIOA->PIO_CODR = 0b1111111111<<16;
		//PIOB->PIO_CODR = 15;
		//PIOB->PIO_SODR = 1;
		//C = video_H[indexes[num][incr++]] - 16;
		//D = video_H[indexes[num][incr++]] - 128;
		//E = video_H[indexes[num][incr++]] - 128;
		//PIOB->PIO_CODR = 15<<4;
		//PIOB->PIO_SODR = 1<<4;
		//PIOA->PIO_CODR = 0b1111111111<<16;
		//PIOA->PIO_SODR = (205+( 298 * C           + 409 * E + 128))<<16;
		//PIOB->PIO_CODR = 15<<4;
		//PIOB->PIO_SODR = 1<<4;
		//PIOA->PIO_CODR = 0b1111111111<<16;
		//PIOA->PIO_SODR = (205+( 298 * C - 100 * D - 208 * E + 128))<<16;
		//PIOB->PIO_CODR = 15<<4;
		//PIOB->PIO_SODR = 1<<4;
		//PIOA->PIO_CODR = 0b1111111111<<16;
		//PIOA->PIO_SODR = (205+( 298 * C + 516 * D           + 128))<<16;
		//PIOA->PIO_CODR = 0b1111111111<<16;
		//PIOB->PIO_CODR = 15;
		//PIOB->PIO_SODR = 1;
		//C = video_H[indexes[num][incr++]] - 16;
		//D = video_H[indexes[num][incr++]] - 128;
		//E = video_H[indexes[num][incr++]] - 128;
		//PIOB->PIO_CODR = 15<<4;
		//PIOB->PIO_SODR = 1<<4;
		//PIOA->PIO_CODR = 0b1111111111<<16;
		//PIOA->PIO_SODR = (205+( 298 * C           + 409 * E + 128))<<16;
		//PIOB->PIO_CODR = 15<<4;
		//PIOB->PIO_SODR = 1<<4;
		//PIOA->PIO_CODR = 0b1111111111<<16;
		//PIOA->PIO_SODR = (205+( 298 * C - 100 * D - 208 * E + 128))<<16;
		//PIOB->PIO_CODR = 15<<4;
		//PIOB->PIO_SODR = 1<<4;
		//PIOA->PIO_CODR = 0b1111111111<<16;
		//PIOA->PIO_SODR = (205+( 298 * C + 516 * D           + 128))<<16;
		//PIOA->PIO_CODR = 0b1111111111<<16;
		//
		//PIOB->PIO_CODR = 15;
		//PIOB->PIO_SODR = 1;
		//C = video_H[indexes[num][incr++]] - 16;
		//D = video_H[indexes[num][incr++]] - 128;
		//E = video_H[indexes[num][incr++]] - 128;
		//PIOB->PIO_CODR = 15<<4;
		//PIOB->PIO_SODR = 1<<4;
		//PIOA->PIO_CODR = 0b1111111111<<16;
		//PIOA->PIO_SODR = (205+( 298 * C           + 409 * E + 128))<<16;
		//PIOB->PIO_CODR = 15<<4;
		//PIOB->PIO_SODR = 1<<4;
		//PIOA->PIO_CODR = 0b1111111111<<16;
		//PIOA->PIO_SODR = (205+( 298 * C - 100 * D - 208 * E + 128))<<16;
		//PIOB->PIO_CODR = 15<<4;
		//PIOB->PIO_SODR = 1<<4;
		//PIOA->PIO_CODR = 0b1111111111<<16;
		//PIOA->PIO_SODR = (205+( 298 * C + 516 * D           + 128))<<16;
		//PIOA->PIO_CODR = 0b1111111111<<16;
		//PIOB->PIO_CODR = 15;
		//PIOB->PIO_SODR = 1;
		//C = video_H[indexes[num][incr++]] - 16;
		//D = video_H[indexes[num][incr++]] - 128;
		//E = video_H[indexes[num][incr++]] - 128;
		//PIOB->PIO_CODR = 15<<4;
		//PIOB->PIO_SODR = 1<<4;
		//PIOA->PIO_CODR = 0b1111111111<<16;
		//PIOA->PIO_SODR = (205+( 298 * C           + 409 * E + 128))<<16;
		//PIOB->PIO_CODR = 15<<4;
		//PIOB->PIO_SODR = 1<<4;
		//PIOA->PIO_CODR = 0b1111111111<<16;
		//PIOA->PIO_SODR = (205+( 298 * C - 100 * D - 208 * E + 128))<<16;
		//PIOB->PIO_CODR = 15<<4;
		//PIOB->PIO_SODR = 1<<4;
		//PIOA->PIO_CODR = 0b1111111111<<16;
		//PIOA->PIO_SODR = (205+( 298 * C + 516 * D           + 128))<<16;
		//PIOA->PIO_CODR = 0b1111111111<<16;
		//PIOB->PIO_CODR = 15;
		//PIOB->PIO_SODR = 1;
		//C = video_H[indexes[num][incr++]] - 16;
		//D = video_H[indexes[num][incr++]] - 128;
		//E = video_H[indexes[num][incr++]] - 128;
		//PIOB->PIO_CODR = 15<<4;
		//PIOB->PIO_SODR = 1<<4;
		//PIOA->PIO_CODR = 0b1111111111<<16;
		//PIOA->PIO_SODR = (205+( 298 * C           + 409 * E + 128))<<16;
		//PIOB->PIO_CODR = 15<<4;
		//PIOB->PIO_SODR = 1<<4;
		//PIOA->PIO_CODR = 0b1111111111<<16;
		//PIOA->PIO_SODR = (205+( 298 * C - 100 * D - 208 * E + 128))<<16;
		//PIOB->PIO_CODR = 15<<4;
		//PIOB->PIO_SODR = 1<<4;
		//PIOA->PIO_CODR = 0b1111111111<<16;
		//PIOA->PIO_SODR = (205+( 298 * C + 516 * D           + 128))<<16;
		//PIOA->PIO_CODR = 0b1111111111<<16;
		//PIOB->PIO_CODR = 15;
		//PIOB->PIO_SODR = 1;
		//C = video_H[indexes[num][incr++]] - 16;
		//D = video_H[indexes[num][incr++]] - 128;
		//E = video_H[indexes[num][incr++]] - 128;
		//PIOB->PIO_CODR = 15<<4;
		//PIOB->PIO_SODR = 1<<4;
		//PIOA->PIO_CODR = 0b1111111111<<16;
		//PIOA->PIO_SODR = (205+( 298 * C           + 409 * E + 128))<<16;
		//PIOB->PIO_CODR = 15<<4;
		//PIOB->PIO_SODR = 1<<4;
		//PIOA->PIO_CODR = 0b1111111111<<16;
		//PIOA->PIO_SODR = (205+( 298 * C - 100 * D - 208 * E + 128))<<16;
		//PIOB->PIO_CODR = 15<<4;
		//PIOB->PIO_SODR = 1<<4;
		//PIOA->PIO_CODR = 0b1111111111<<16;
		//PIOA->PIO_SODR = (205+( 298 * C + 516 * D           + 128))<<16;
		//PIOA->PIO_CODR = 0b1111111111<<16;
		//PIOB->PIO_CODR = 15;
		//PIOB->PIO_SODR = 1;
		//C = video_H[indexes[num][incr++]] - 16;
		//D = video_H[indexes[num][incr++]] - 128;
		//E = video_H[indexes[num][incr++]] - 128;
		//PIOB->PIO_CODR = 15<<4;
		//PIOB->PIO_SODR = 1<<4;
		//PIOA->PIO_CODR = 0b1111111111<<16;
		//PIOA->PIO_SODR = (205+( 298 * C           + 409 * E + 128))<<16;
		//PIOB->PIO_CODR = 15<<4;
		//PIOB->PIO_SODR = 1<<4;
		//PIOA->PIO_CODR = 0b1111111111<<16;
		//PIOA->PIO_SODR = (205+( 298 * C - 100 * D - 208 * E + 128))<<16;
		//PIOB->PIO_CODR = 15<<4;
		//PIOB->PIO_SODR = 1<<4;
		//PIOA->PIO_CODR = 0b1111111111<<16;
		//PIOA->PIO_SODR = (205+( 298 * C + 516 * D           + 128))<<16;
		//PIOA->PIO_CODR = 0b1111111111<<16;
		//
		//PIOB->PIO_CODR = 15;
		//PIOB->PIO_SODR = 1;
		//C = video_H[indexes[num][incr++]] - 16;
		//D = video_H[indexes[num][incr++]] - 128;
		//E = video_H[indexes[num][incr++]] - 128;
		//PIOB->PIO_CODR = 15<<4;
		//PIOB->PIO_SODR = 1<<4;
		//PIOA->PIO_CODR = 0b1111111111<<16;
		//PIOA->PIO_SODR = (205+( 298 * C           + 409 * E + 128))<<16;
		//PIOB->PIO_CODR = 15<<4;
		//PIOB->PIO_SODR = 1<<4;
		//PIOA->PIO_CODR = 0b1111111111<<16;
		//PIOA->PIO_SODR = (205+( 298 * C - 100 * D - 208 * E + 128))<<16;
		//PIOB->PIO_CODR = 15<<4;
		//PIOB->PIO_SODR = 1<<4;
		//PIOA->PIO_CODR = 0b1111111111<<16;
		//PIOA->PIO_SODR = (205+( 298 * C + 516 * D           + 128))<<16;
		//PIOA->PIO_CODR = 0b1111111111<<16;
		//PIOB->PIO_CODR = 15;
		//PIOB->PIO_SODR = 1;
		//C = video_H[indexes[num][incr++]] - 16;
		//D = video_H[indexes[num][incr++]] - 128;
		//E = video_H[indexes[num][incr++]] - 128;
		//PIOB->PIO_CODR = 15<<4;
		//PIOB->PIO_SODR = 1<<4;
		//PIOA->PIO_CODR = 0b1111111111<<16;
		//PIOA->PIO_SODR = (205+( 298 * C           + 409 * E + 128))<<16;
		//PIOB->PIO_CODR = 15<<4;
		//PIOB->PIO_SODR = 1<<4;
		//PIOA->PIO_CODR = 0b1111111111<<16;
		//PIOA->PIO_SODR = (205+( 298 * C - 100 * D - 208 * E + 128))<<16;
		//PIOB->PIO_CODR = 15<<4;
		//PIOB->PIO_SODR = 1<<4;
		//PIOA->PIO_CODR = 0b1111111111<<16;
		//PIOA->PIO_SODR = (205+( 298 * C + 516 * D           + 128))<<16;
		//PIOA->PIO_CODR = 0b1111111111<<16;
		//PIOB->PIO_CODR = 15;
		//PIOB->PIO_SODR = 1;
		//C = video_H[indexes[num][incr++]] - 16;
		//D = video_H[indexes[num][incr++]] - 128;
		//E = video_H[indexes[num][incr++]] - 128;
		//PIOB->PIO_CODR = 15<<4;
		//PIOB->PIO_SODR = 1<<4;
		//PIOA->PIO_CODR = 0b1111111111<<16;
		//PIOA->PIO_SODR = (205+( 298 * C           + 409 * E + 128))<<16;
		//PIOB->PIO_CODR = 15<<4;
		//PIOB->PIO_SODR = 1<<4;
		//PIOA->PIO_CODR = 0b1111111111<<16;
		//PIOA->PIO_SODR = (205+( 298 * C - 100 * D - 208 * E + 128))<<16;
		//PIOB->PIO_CODR = 15<<4;
		//PIOB->PIO_SODR = 1<<4;
		//PIOA->PIO_CODR = 0b1111111111<<16;
		//PIOA->PIO_SODR = (205+( 298 * C + 516 * D           + 128))<<16;
		//PIOA->PIO_CODR = 0b1111111111<<16;
		//PIOB->PIO_CODR = 15;
		//PIOB->PIO_SODR = 1;
		//C = video_H[indexes[num][incr++]] - 16;
		//D = video_H[indexes[num][incr++]] - 128;
		//E = video_H[indexes[num][incr++]] - 128;
		//PIOB->PIO_CODR = 15<<4;
		//PIOB->PIO_SODR = 1<<4;
		//PIOA->PIO_CODR = 0b1111111111<<16;
		//PIOA->PIO_SODR = (205+( 298 * C           + 409 * E + 128))<<16;
		//PIOB->PIO_CODR = 15<<4;
		//PIOB->PIO_SODR = 1<<4;
		//PIOA->PIO_CODR = 0b1111111111<<16;
		//PIOA->PIO_SODR = (205+( 298 * C - 100 * D - 208 * E + 128))<<16;
		//PIOB->PIO_CODR = 15<<4;
		//PIOB->PIO_SODR = 1<<4;
		//PIOA->PIO_CODR = 0b1111111111<<16;
		//PIOA->PIO_SODR = (205+( 298 * C + 516 * D           + 128))<<16;
		//PIOA->PIO_CODR = 0b1111111111<<16;
		//PIOB->PIO_CODR = 15;
		//PIOB->PIO_SODR = 1;
		//C = video_H[indexes[num][incr++]] - 16;
		//D = video_H[indexes[num][incr++]] - 128;
		//E = video_H[indexes[num][incr++]] - 128;
		//PIOB->PIO_CODR = 15<<4;
		//PIOB->PIO_SODR = 1<<4;
		//PIOA->PIO_CODR = 0b1111111111<<16;
		//PIOA->PIO_SODR = (205+( 298 * C           + 409 * E + 128))<<16;
		//PIOB->PIO_CODR = 15<<4;
		//PIOB->PIO_SODR = 1<<4;
		//PIOA->PIO_CODR = 0b1111111111<<16;
		//PIOA->PIO_SODR = (205+( 298 * C - 100 * D - 208 * E + 128))<<16;
		//PIOB->PIO_CODR = 15<<4;
		//PIOB->PIO_SODR = 1<<4;
		//PIOA->PIO_CODR = 0b1111111111<<16;
		//PIOA->PIO_SODR = (205+( 298 * C + 516 * D           + 128))<<16;
		//PIOA->PIO_CODR = 0b1111111111<<16;
		//
		//PIOB->PIO_CODR = 15;
		//PIOB->PIO_SODR = 1;
		//C = video_H[indexes[num][incr++]] - 16;
		//D = video_H[indexes[num][incr++]] - 128;
		//E = video_H[indexes[num][incr++]] - 128;
		//PIOB->PIO_CODR = 15<<4;
		//PIOB->PIO_SODR = 1<<4;
		//PIOA->PIO_CODR = 0b1111111111<<16;
		//PIOA->PIO_SODR = (205+( 298 * C           + 409 * E + 128))<<16;
		//PIOB->PIO_CODR = 15<<4;
		//PIOB->PIO_SODR = 1<<4;
		//PIOA->PIO_CODR = 0b1111111111<<16;
		//PIOA->PIO_SODR = (205+( 298 * C - 100 * D - 208 * E + 128))<<16;
		//PIOB->PIO_CODR = 15<<4;
		//PIOB->PIO_SODR = 1<<4;
		//PIOA->PIO_CODR = 0b1111111111<<16;
		//PIOA->PIO_SODR = (205+( 298 * C + 516 * D           + 128))<<16;
		//PIOA->PIO_CODR = 0b1111111111<<16;
		//PIOB->PIO_CODR = 15;
		//PIOB->PIO_SODR = 1;
		//C = video_H[indexes[num][incr++]] - 16;
		//D = video_H[indexes[num][incr++]] - 128;
		//E = video_H[indexes[num][incr++]] - 128;
		//PIOB->PIO_CODR = 15<<4;
		//PIOB->PIO_SODR = 1<<4;
		//PIOA->PIO_CODR = 0b1111111111<<16;
		//PIOA->PIO_SODR = (205+( 298 * C           + 409 * E + 128))<<16;
		//PIOB->PIO_CODR = 15<<4;
		//PIOB->PIO_SODR = 1<<4;
		//PIOA->PIO_CODR = 0b1111111111<<16;
		//PIOA->PIO_SODR = (205+( 298 * C - 100 * D - 208 * E + 128))<<16;
		//PIOB->PIO_CODR = 15<<4;
		//PIOB->PIO_SODR = 1<<4;
		//PIOA->PIO_CODR = 0b1111111111<<16;
		//PIOA->PIO_SODR = (205+( 298 * C + 516 * D           + 128))<<16;
		//PIOA->PIO_CODR = 0b1111111111<<16;
		//PIOB->PIO_CODR = 15;
		//PIOB->PIO_SODR = 1;
		//C = video_H[indexes[num][incr++]] - 16;
		//D = video_H[indexes[num][incr++]] - 128;
		//E = video_H[indexes[num][incr++]] - 128;
		//PIOB->PIO_CODR = 15<<4;
		//PIOB->PIO_SODR = 1<<4;
		//PIOA->PIO_CODR = 0b1111111111<<16;
		//PIOA->PIO_SODR = (205+( 298 * C           + 409 * E + 128))<<16;
		//PIOB->PIO_CODR = 15<<4;
		//PIOB->PIO_SODR = 1<<4;
		//PIOA->PIO_CODR = 0b1111111111<<16;
		//PIOA->PIO_SODR = (205+( 298 * C - 100 * D - 208 * E + 128))<<16;
		//PIOB->PIO_CODR = 15<<4;
		//PIOB->PIO_SODR = 1<<4;
		//PIOA->PIO_CODR = 0b1111111111<<16;
		//PIOA->PIO_SODR = (205+( 298 * C + 516 * D           + 128))<<16;
		//PIOA->PIO_CODR = 0b1111111111<<16;
		//PIOB->PIO_CODR = 15;
		//PIOB->PIO_SODR = 1;
		//C = video_H[indexes[num][incr++]] - 16;
		//D = video_H[indexes[num][incr++]] - 128;
		//E = video_H[indexes[num][incr++]] - 128;
		//PIOB->PIO_CODR = 15<<4;
		//PIOB->PIO_SODR = 1<<4;
		//PIOA->PIO_CODR = 0b1111111111<<16;
		//PIOA->PIO_SODR = (205+( 298 * C           + 409 * E + 128))<<16;
		//PIOB->PIO_CODR = 15<<4;
		//PIOB->PIO_SODR = 1<<4;
		//PIOA->PIO_CODR = 0b1111111111<<16;
		//PIOA->PIO_SODR = (205+( 298 * C - 100 * D - 208 * E + 128))<<16;
		//PIOB->PIO_CODR = 15<<4;
		//PIOB->PIO_SODR = 1<<4;
		//PIOA->PIO_CODR = 0b1111111111<<16;
		//PIOA->PIO_SODR = (205+( 298 * C + 516 * D           + 128))<<16;
		//PIOA->PIO_CODR = 0b1111111111<<16;
		//PIOB->PIO_CODR = 15;
		//PIOB->PIO_SODR = 1;
		//C = video_H[indexes[num][incr++]] - 16;
		//D = video_H[indexes[num][incr++]] - 128;
		//E = video_H[indexes[num][incr++]] - 128;
		//PIOB->PIO_CODR = 15<<4;
		//PIOB->PIO_SODR = 1<<4;
		//PIOA->PIO_CODR = 0b1111111111<<16;
		//PIOA->PIO_SODR = (205+( 298 * C           + 409 * E + 128))<<16;
		//PIOB->PIO_CODR = 15<<4;
		//PIOB->PIO_SODR = 1<<4;
		//PIOA->PIO_CODR = 0b1111111111<<16;
		//PIOA->PIO_SODR = (205+( 298 * C - 100 * D - 208 * E + 128))<<16;
		//PIOB->PIO_CODR = 15<<4;
		//PIOB->PIO_SODR = 1<<4;
		//PIOA->PIO_CODR = 0b1111111111<<16;
		//PIOA->PIO_SODR = (205+( 298 * C + 516 * D           + 128))<<16;
		//PIOA->PIO_CODR = 0b1111111111<<16;
		//
		//PIOB->PIO_CODR = 15;
		//PIOB->PIO_SODR = 1;
		//C = video_H[indexes[num][incr++]] - 16;
		//D = video_H[indexes[num][incr++]] - 128;
		//E = video_H[indexes[num][incr++]] - 128;
		//PIOB->PIO_CODR = 15<<4;
		//PIOB->PIO_SODR = 1<<4;
		//PIOA->PIO_CODR = 0b1111111111<<16;
		//PIOA->PIO_SODR = (205+( 298 * C           + 409 * E + 128))<<16;
		//PIOB->PIO_CODR = 15<<4;
		//PIOB->PIO_SODR = 1<<4;
		//PIOA->PIO_CODR = 0b1111111111<<16;
		//PIOA->PIO_SODR = (205+( 298 * C - 100 * D - 208 * E + 128))<<16;
		//PIOB->PIO_CODR = 15<<4;
		//PIOB->PIO_SODR = 1<<4;
		//PIOA->PIO_CODR = 0b1111111111<<16;
		//PIOA->PIO_SODR = (205+( 298 * C + 516 * D           + 128))<<16;
		//PIOA->PIO_CODR = 0b1111111111<<16;
		//PIOB->PIO_CODR = 15;
		//PIOB->PIO_SODR = 1;
		//C = video_H[indexes[num][incr++]] - 16;
		//D = video_H[indexes[num][incr++]] - 128;
		//E = video_H[indexes[num][incr++]] - 128;
		//PIOB->PIO_CODR = 15<<4;
		//PIOB->PIO_SODR = 1<<4;
		//PIOA->PIO_CODR = 0b1111111111<<16;
		//PIOA->PIO_SODR = (205+( 298 * C           + 409 * E + 128))<<16;
		//PIOB->PIO_CODR = 15<<4;
		//PIOB->PIO_SODR = 1<<4;
		//PIOA->PIO_CODR = 0b1111111111<<16;
		//PIOA->PIO_SODR = (205+( 298 * C - 100 * D - 208 * E + 128))<<16;
		//PIOB->PIO_CODR = 15<<4;
		//PIOB->PIO_SODR = 1<<4;
		//PIOA->PIO_CODR = 0b1111111111<<16;
		//PIOA->PIO_SODR = (205+( 298 * C + 516 * D           + 128))<<16;
		//PIOA->PIO_CODR = 0b1111111111<<16;
		//PIOB->PIO_CODR = 15;
		//PIOB->PIO_SODR = 1;
		//C = video_H[indexes[num][incr++]] - 16;
		//D = video_H[indexes[num][incr++]] - 128;
		//E = video_H[indexes[num][incr++]] - 128;
		//PIOB->PIO_CODR = 15<<4;
		//PIOB->PIO_SODR = 1<<4;
		//PIOA->PIO_CODR = 0b1111111111<<16;
		//PIOA->PIO_SODR = (205+( 298 * C           + 409 * E + 128))<<16;
		//PIOB->PIO_CODR = 15<<4;
		//PIOB->PIO_SODR = 1<<4;
		//PIOA->PIO_CODR = 0b1111111111<<16;
		//PIOA->PIO_SODR = (205+( 298 * C - 100 * D - 208 * E + 128))<<16;
		//PIOB->PIO_CODR = 15<<4;
		//PIOB->PIO_SODR = 1<<4;
		//PIOA->PIO_CODR = 0b1111111111<<16;
		//PIOA->PIO_SODR = (205+( 298 * C + 516 * D           + 128))<<16;
		//PIOA->PIO_CODR = 0b1111111111<<16;
		//PIOB->PIO_CODR = 15;
		//PIOB->PIO_SODR = 1;
		//C = video_H[indexes[num][incr++]] - 16;
		//D = video_H[indexes[num][incr++]] - 128;
		//E = video_H[indexes[num][incr++]] - 128;
		//PIOB->PIO_CODR = 15<<4;
		//PIOB->PIO_SODR = 1<<4;
		//PIOA->PIO_CODR = 0b1111111111<<16;
		//PIOA->PIO_SODR = (205+( 298 * C           + 409 * E + 128))<<16;
		//PIOB->PIO_CODR = 15<<4;
		//PIOB->PIO_SODR = 1<<4;
		//PIOA->PIO_CODR = 0b1111111111<<16;
		//PIOA->PIO_SODR = (205+( 298 * C - 100 * D - 208 * E + 128))<<16;
		//PIOB->PIO_CODR = 15<<4;
		//PIOB->PIO_SODR = 1<<4;
		//PIOA->PIO_CODR = 0b1111111111<<16;
		//PIOA->PIO_SODR = (205+( 298 * C + 516 * D           + 128))<<16;
		//PIOA->PIO_CODR = 0b1111111111<<16;
		//PIOB->PIO_CODR = 15;
		//PIOB->PIO_SODR = 1;
		//C = video_H[indexes[num][incr++]] - 16;
		//D = video_H[indexes[num][incr++]] - 128;
		//E = video_H[indexes[num][incr++]] - 128;
		//PIOB->PIO_CODR = 15<<4;
		//PIOB->PIO_SODR = 1<<4;
		//PIOA->PIO_CODR = 0b1111111111<<16;
		//PIOA->PIO_SODR = (205+( 298 * C           + 409 * E + 128))<<16;
		//PIOB->PIO_CODR = 15<<4;
		//PIOB->PIO_SODR = 1<<4;
		//PIOA->PIO_CODR = 0b1111111111<<16;
		//PIOA->PIO_SODR = (205+( 298 * C - 100 * D - 208 * E + 128))<<16;
		//PIOB->PIO_CODR = 15<<4;
		//PIOB->PIO_SODR = 1<<4;
		//PIOA->PIO_CODR = 0b1111111111<<16;
		//PIOA->PIO_SODR = (205+( 298 * C + 516 * D           + 128))<<16;
		//PIOA->PIO_CODR = 0b1111111111<<16;
		//
		//PIOB->PIO_CODR = 15;
		//PIOB->PIO_SODR = 1;
		//C = video_H[indexes[num][incr++]] - 16;
		//D = video_H[indexes[num][incr++]] - 128;
		//E = video_H[indexes[num][incr++]] - 128;
		//PIOB->PIO_CODR = 15<<4;
		//PIOB->PIO_SODR = 1<<4;
		//PIOA->PIO_CODR = 0b1111111111<<16;
		//PIOA->PIO_SODR = (205+( 298 * C           + 409 * E + 128))<<16;
		//PIOB->PIO_CODR = 15<<4;
		//PIOB->PIO_SODR = 1<<4;
		//PIOA->PIO_CODR = 0b1111111111<<16;
		//PIOA->PIO_SODR = (205+( 298 * C - 100 * D - 208 * E + 128))<<16;
		//PIOB->PIO_CODR = 15<<4;
		//PIOB->PIO_SODR = 1<<4;
		//PIOA->PIO_CODR = 0b1111111111<<16;
		//PIOA->PIO_SODR = (205+( 298 * C + 516 * D           + 128))<<16;
		//PIOA->PIO_CODR = 0b1111111111<<16;
		//PIOB->PIO_CODR = 15;
		//PIOB->PIO_SODR = 1;
		//C = video_H[indexes[num][incr++]] - 16;
		//D = video_H[indexes[num][incr++]] - 128;
		//E = video_H[indexes[num][incr++]] - 128;
		//PIOB->PIO_CODR = 15<<4;
		//PIOB->PIO_SODR = 1<<4;
		//PIOA->PIO_CODR = 0b1111111111<<16;
		//PIOA->PIO_SODR = (205+( 298 * C           + 409 * E + 128))<<16;
		//PIOB->PIO_CODR = 15<<4;
		//PIOB->PIO_SODR = 1<<4;
		//PIOA->PIO_CODR = 0b1111111111<<16;
		//PIOA->PIO_SODR = (205+( 298 * C - 100 * D - 208 * E + 128))<<16;
		//PIOB->PIO_CODR = 15<<4;
		//PIOB->PIO_SODR = 1<<4;
		//PIOA->PIO_CODR = 0b1111111111<<16;
		//PIOA->PIO_SODR = (205+( 298 * C + 516 * D           + 128))<<16;
		//PIOA->PIO_CODR = 0b1111111111<<16;
		//PIOB->PIO_CODR = 15;
		//PIOB->PIO_SODR = 1;
		//C = video_H[indexes[num][incr++]] - 16;
		//D = video_H[indexes[num][incr++]] - 128;
		//E = video_H[indexes[num][incr++]] - 128;
		//PIOB->PIO_CODR = 15<<4;
		//PIOB->PIO_SODR = 1<<4;
		//PIOA->PIO_CODR = 0b1111111111<<16;
		//PIOA->PIO_SODR = (205+( 298 * C           + 409 * E + 128))<<16;
		//PIOB->PIO_CODR = 15<<4;
		//PIOB->PIO_SODR = 1<<4;
		//PIOA->PIO_CODR = 0b1111111111<<16;
		//PIOA->PIO_SODR = (205+( 298 * C - 100 * D - 208 * E + 128))<<16;
		//PIOB->PIO_CODR = 15<<4;
		//PIOB->PIO_SODR = 1<<4;
		//PIOA->PIO_CODR = 0b1111111111<<16;
		//PIOA->PIO_SODR = (205+( 298 * C + 516 * D           + 128))<<16;
		//PIOA->PIO_CODR = 0b1111111111<<16;
		//PIOB->PIO_CODR = 15;
		//PIOB->PIO_SODR = 1;
		//C = video_H[indexes[num][incr++]] - 16;
		//D = video_H[indexes[num][incr++]] - 128;
		//E = video_H[indexes[num][incr++]] - 128;
		//PIOB->PIO_CODR = 15<<4;
		//PIOB->PIO_SODR = 1<<4;
		//PIOA->PIO_CODR = 0b1111111111<<16;
		//PIOA->PIO_SODR = (205+( 298 * C           + 409 * E + 128))<<16;
		//PIOB->PIO_CODR = 15<<4;
		//PIOB->PIO_SODR = 1<<4;
		//PIOA->PIO_CODR = 0b1111111111<<16;
		//PIOA->PIO_SODR = (205+( 298 * C - 100 * D - 208 * E + 128))<<16;
		//PIOB->PIO_CODR = 15<<4;
		//PIOB->PIO_SODR = 1<<4;
		//PIOA->PIO_CODR = 0b1111111111<<16;
		//PIOA->PIO_SODR = (205+( 298 * C + 516 * D           + 128))<<16;
		//PIOA->PIO_CODR = 0b1111111111<<16;
		//PIOB->PIO_CODR = 15;
		//PIOB->PIO_SODR = 1;
		//C = video_H[indexes[num][incr++]] - 16;
		//D = video_H[indexes[num][incr++]] - 128;
		//E = video_H[indexes[num][incr++]] - 128;
		//PIOB->PIO_CODR = 15<<4;
		//PIOB->PIO_SODR = 1<<4;
		//PIOA->PIO_CODR = 0b1111111111<<16;
		//PIOA->PIO_SODR = (205+( 298 * C           + 409 * E + 128))<<16;
		//PIOB->PIO_CODR = 15<<4;
		//PIOB->PIO_SODR = 1<<4;
		//PIOA->PIO_CODR = 0b1111111111<<16;
		//PIOA->PIO_SODR = (205+( 298 * C - 100 * D - 208 * E + 128))<<16;
		//PIOB->PIO_CODR = 15<<4;
		//PIOB->PIO_SODR = 1<<4;
		//PIOA->PIO_CODR = 0b1111111111<<16;
		//PIOA->PIO_SODR = (205+( 298 * C + 516 * D           + 128))<<16;
		//PIOA->PIO_CODR = 0b1111111111<<16;
		//
		//PIOB->PIO_CODR = 15;
		//PIOB->PIO_SODR = 1;
		//C = video_H[indexes[num][incr++]] - 16;
		//D = video_H[indexes[num][incr++]] - 128;
		//E = video_H[indexes[num][incr++]] - 128;
		//PIOB->PIO_CODR = 15<<4;
		//PIOB->PIO_SODR = 1<<4;
		//PIOA->PIO_CODR = 0b1111111111<<16;
		//PIOA->PIO_SODR = (205+( 298 * C           + 409 * E + 128))<<16;
		//PIOB->PIO_CODR = 15<<4;
		//PIOB->PIO_SODR = 1<<4;
		//PIOA->PIO_CODR = 0b1111111111<<16;
		//PIOA->PIO_SODR = (205+( 298 * C - 100 * D - 208 * E + 128))<<16;
		//PIOB->PIO_CODR = 15<<4;
		//PIOB->PIO_SODR = 1<<4;
		//PIOA->PIO_CODR = 0b1111111111<<16;
		//PIOA->PIO_SODR = (205+( 298 * C + 516 * D           + 128))<<16;
		//PIOA->PIO_CODR = 0b1111111111<<16;
		//PIOB->PIO_CODR = 15;
		//PIOB->PIO_SODR = 1;
		//C = video_H[indexes[num][incr++]] - 16;
		//D = video_H[indexes[num][incr++]] - 128;
		//E = video_H[indexes[num][incr++]] - 128;
		//PIOB->PIO_CODR = 15<<4;
		//PIOB->PIO_SODR = 1<<4;
		//PIOA->PIO_CODR = 0b1111111111<<16;
		//PIOA->PIO_SODR = (205+( 298 * C           + 409 * E + 128))<<16;
		//PIOB->PIO_CODR = 15<<4;
		//PIOB->PIO_SODR = 1<<4;
		//PIOA->PIO_CODR = 0b1111111111<<16;
		//PIOA->PIO_SODR = (205+( 298 * C - 100 * D - 208 * E + 128))<<16;
		//PIOB->PIO_CODR = 15<<4;
		//PIOB->PIO_SODR = 1<<4;
		//PIOA->PIO_CODR = 0b1111111111<<16;
		//PIOA->PIO_SODR = (205+( 298 * C + 516 * D           + 128))<<16;
		//PIOA->PIO_CODR = 0b1111111111<<16;
		//PIOB->PIO_CODR = 15;
		//PIOB->PIO_SODR = 1;
		//C = video_H[indexes[num][incr++]] - 16;
		//D = video_H[indexes[num][incr++]] - 128;
		//E = video_H[indexes[num][incr++]] - 128;
		//PIOB->PIO_CODR = 15<<4;
		//PIOB->PIO_SODR = 1<<4;
		//PIOA->PIO_CODR = 0b1111111111<<16;
		//PIOA->PIO_SODR = (205+( 298 * C           + 409 * E + 128))<<16;
		//PIOB->PIO_CODR = 15<<4;
		//PIOB->PIO_SODR = 1<<4;
		//PIOA->PIO_CODR = 0b1111111111<<16;
		//PIOA->PIO_SODR = (205+( 298 * C - 100 * D - 208 * E + 128))<<16;
		//PIOB->PIO_CODR = 15<<4;
		//PIOB->PIO_SODR = 1<<4;
		//PIOA->PIO_CODR = 0b1111111111<<16;
		//PIOA->PIO_SODR = (205+( 298 * C + 516 * D           + 128))<<16;
		//PIOA->PIO_CODR = 0b1111111111<<16;
		//PIOB->PIO_CODR = 15;
		//PIOB->PIO_SODR = 1;
		//C = video_H[indexes[num][incr++]] - 16;
		//D = video_H[indexes[num][incr++]] - 128;
		//E = video_H[indexes[num][incr++]] - 128;
		//PIOB->PIO_CODR = 15<<4;
		//PIOB->PIO_SODR = 1<<4;
		//PIOA->PIO_CODR = 0b1111111111<<16;
		//PIOA->PIO_SODR = (205+( 298 * C           + 409 * E + 128))<<16;
		//PIOB->PIO_CODR = 15<<4;
		//PIOB->PIO_SODR = 1<<4;
		//PIOA->PIO_CODR = 0b1111111111<<16;
		//PIOA->PIO_SODR = (205+( 298 * C - 100 * D - 208 * E + 128))<<16;
		//PIOB->PIO_CODR = 15<<4;
		//PIOB->PIO_SODR = 1<<4;
		//PIOA->PIO_CODR = 0b1111111111<<16;
		//PIOA->PIO_SODR = (205+( 298 * C + 516 * D           + 128))<<16;
		//PIOA->PIO_CODR = 0b1111111111<<16;
		//PIOB->PIO_CODR = 15;
		//PIOB->PIO_SODR = 1;
		//C = video_H[indexes[num][incr++]] - 16;
		//D = video_H[indexes[num][incr++]] - 128;
		//E = video_H[indexes[num][incr++]] - 128;
		//PIOB->PIO_CODR = 15<<4;
		//PIOB->PIO_SODR = 1<<4;
		//PIOA->PIO_CODR = 0b1111111111<<16;
		//PIOA->PIO_SODR = (205+( 298 * C           + 409 * E + 128))<<16;
		//PIOB->PIO_CODR = 15<<4;
		//PIOB->PIO_SODR = 1<<4;
		//PIOA->PIO_CODR = 0b1111111111<<16;
		//PIOA->PIO_SODR = (205+( 298 * C - 100 * D - 208 * E + 128))<<16;
		//PIOB->PIO_CODR = 15<<4;
		//PIOB->PIO_SODR = 1<<4;
		//PIOA->PIO_CODR = 0b1111111111<<16;
		//PIOA->PIO_SODR = (205+( 298 * C + 516 * D           + 128))<<16;
		//PIOA->PIO_CODR = 0b1111111111<<16;
		//
		//PIOB->PIO_CODR = 15;
		//PIOB->PIO_SODR = 1;
		//C = video_H[indexes[num][incr++]] - 16;
		//D = video_H[indexes[num][incr++]] - 128;
		//E = video_H[indexes[num][incr++]] - 128;
		//PIOB->PIO_CODR = 15<<4;
		//PIOB->PIO_SODR = 1<<4;
		//PIOA->PIO_CODR = 0b1111111111<<16;
		//PIOA->PIO_SODR = (205+( 298 * C           + 409 * E + 128))<<16;
		//PIOB->PIO_CODR = 15<<4;
		//PIOB->PIO_SODR = 1<<4;
		//PIOA->PIO_CODR = 0b1111111111<<16;
		//PIOA->PIO_SODR = (205+( 298 * C - 100 * D - 208 * E + 128))<<16;
		//PIOB->PIO_CODR = 15<<4;
		//PIOB->PIO_SODR = 1<<4;
		//PIOA->PIO_CODR = 0b1111111111<<16;
		//PIOA->PIO_SODR = (205+( 298 * C + 516 * D           + 128))<<16;
		//PIOA->PIO_CODR = 0b1111111111<<16;
		//PIOB->PIO_CODR = 15;
		//PIOB->PIO_SODR = 1;
		//C = video_H[indexes[num][incr++]] - 16;
		//D = video_H[indexes[num][incr++]] - 128;
		//E = video_H[indexes[num][incr++]] - 128;
		//PIOB->PIO_CODR = 15<<4;
		//PIOB->PIO_SODR = 1<<4;
		//PIOA->PIO_CODR = 0b1111111111<<16;
		//PIOA->PIO_SODR = (205+( 298 * C           + 409 * E + 128))<<16;
		//PIOB->PIO_CODR = 15<<4;
		//PIOB->PIO_SODR = 1<<4;
		//PIOA->PIO_CODR = 0b1111111111<<16;
		//PIOA->PIO_SODR = (205+( 298 * C - 100 * D - 208 * E + 128))<<16;
		//PIOB->PIO_CODR = 15<<4;
		//PIOB->PIO_SODR = 1<<4;
		//PIOA->PIO_CODR = 0b1111111111<<16;
		//PIOA->PIO_SODR = (205+( 298 * C + 516 * D           + 128))<<16;
		//PIOA->PIO_CODR = 0b1111111111<<16;
		//PIOB->PIO_CODR = 15;
		//PIOB->PIO_SODR = 1;
		//C = video_H[indexes[num][incr++]] - 16;
		//D = video_H[indexes[num][incr++]] - 128;
		//E = video_H[indexes[num][incr++]] - 128;
		//PIOB->PIO_CODR = 15<<4;
		//PIOB->PIO_SODR = 1<<4;
		//PIOA->PIO_CODR = 0b1111111111<<16;
		//PIOA->PIO_SODR = (205+( 298 * C           + 409 * E + 128))<<16;
		//PIOB->PIO_CODR = 15<<4;
		//PIOB->PIO_SODR = 1<<4;
		//PIOA->PIO_CODR = 0b1111111111<<16;
		//PIOA->PIO_SODR = (205+( 298 * C - 100 * D - 208 * E + 128))<<16;
		//PIOB->PIO_CODR = 15<<4;
		//PIOB->PIO_SODR = 1<<4;
		//PIOA->PIO_CODR = 0b1111111111<<16;
		//PIOA->PIO_SODR = (205+( 298 * C + 516 * D           + 128))<<16;
		//PIOA->PIO_CODR = 0b1111111111<<16;
		//PIOB->PIO_CODR = 15;
		//PIOB->PIO_SODR = 1;
		//C = video_H[indexes[num][incr++]] - 16;
		//D = video_H[indexes[num][incr++]] - 128;
		//E = video_H[indexes[num][incr++]] - 128;
		//PIOB->PIO_CODR = 15<<4;
		//PIOB->PIO_SODR = 1<<4;
		//PIOA->PIO_CODR = 0b1111111111<<16;
		//PIOA->PIO_SODR = (205+( 298 * C           + 409 * E + 128))<<16;
		//PIOB->PIO_CODR = 15<<4;
		//PIOB->PIO_SODR = 1<<4;
		//PIOA->PIO_CODR = 0b1111111111<<16;
		//PIOA->PIO_SODR = (205+( 298 * C - 100 * D - 208 * E + 128))<<16;
		//PIOB->PIO_CODR = 15<<4;
		//PIOB->PIO_SODR = 1<<4;
		//PIOA->PIO_CODR = 0b1111111111<<16;
		//PIOA->PIO_SODR = (205+( 298 * C + 516 * D           + 128))<<16;
		//PIOA->PIO_CODR = 0b1111111111<<16;
		//PIOB->PIO_CODR = 15;
		//PIOB->PIO_SODR = 1;
		//C = video_H[indexes[num][incr++]] - 16;
		//D = video_H[indexes[num][incr++]] - 128;
		//E = video_H[indexes[num][incr++]] - 128;
		//PIOB->PIO_CODR = 15<<4;
		//PIOB->PIO_SODR = 1<<4;
		//PIOA->PIO_CODR = 0b1111111111<<16;
		//PIOA->PIO_SODR = (205+( 298 * C           + 409 * E + 128))<<16;
		//PIOB->PIO_CODR = 15<<4;
		//PIOB->PIO_SODR = 1<<4;
		//PIOA->PIO_CODR = 0b1111111111<<16;
		//PIOA->PIO_SODR = (205+( 298 * C - 100 * D - 208 * E + 128))<<16;
		//PIOB->PIO_CODR = 15<<4;
		//PIOB->PIO_SODR = 1<<4;
		//PIOA->PIO_CODR = 0b1111111111<<16;
		//PIOA->PIO_SODR = (205+( 298 * C + 516 * D           + 128))<<16;
		//PIOA->PIO_CODR = 0b1111111111<<16;
		//
		//PIOB->PIO_CODR = 15;
		//PIOB->PIO_SODR = 1;
		//C = video_H[indexes[num][incr++]] - 16;
		//D = video_H[indexes[num][incr++]] - 128;
		//E = video_H[indexes[num][incr++]] - 128;
		//PIOB->PIO_CODR = 15<<4;
		//PIOB->PIO_SODR = 1<<4;
		//PIOA->PIO_CODR = 0b1111111111<<16;
		//PIOA->PIO_SODR = (205+( 298 * C           + 409 * E + 128))<<16;
		//PIOB->PIO_CODR = 15<<4;
		//PIOB->PIO_SODR = 1<<4;
		//PIOA->PIO_CODR = 0b1111111111<<16;
		//PIOA->PIO_SODR = (205+( 298 * C - 100 * D - 208 * E + 128))<<16;
		//PIOB->PIO_CODR = 15<<4;
		//PIOB->PIO_SODR = 1<<4;
		//PIOA->PIO_CODR = 0b1111111111<<16;
		//PIOA->PIO_SODR = (205+( 298 * C + 516 * D           + 128))<<16;
		//PIOA->PIO_CODR = 0b1111111111<<16;
		//PIOB->PIO_CODR = 15;
		//PIOB->PIO_SODR = 1;
		//C = video_H[indexes[num][incr++]] - 16;
		//D = video_H[indexes[num][incr++]] - 128;
		//E = video_H[indexes[num][incr++]] - 128;
		//PIOB->PIO_CODR = 15<<4;
		//PIOB->PIO_SODR = 1<<4;
		//PIOA->PIO_CODR = 0b1111111111<<16;
		//PIOA->PIO_SODR = (205+( 298 * C           + 409 * E + 128))<<16;
		//PIOB->PIO_CODR = 15<<4;
		//PIOB->PIO_SODR = 1<<4;
		//PIOA->PIO_CODR = 0b1111111111<<16;
		//PIOA->PIO_SODR = (205+( 298 * C - 100 * D - 208 * E + 128))<<16;
		//PIOB->PIO_CODR = 15<<4;
		//PIOB->PIO_SODR = 1<<4;
		//PIOA->PIO_CODR = 0b1111111111<<16;
		//PIOA->PIO_SODR = (205+( 298 * C + 516 * D           + 128))<<16;
		//PIOA->PIO_CODR = 0b1111111111<<16;
		//PIOB->PIO_CODR = 15;
		//PIOB->PIO_SODR = 1;
		//C = video_H[indexes[num][incr++]] - 16;
		//D = video_H[indexes[num][incr++]] - 128;
		//E = video_H[indexes[num][incr++]] - 128;
		//PIOB->PIO_CODR = 15<<4;
		//PIOB->PIO_SODR = 1<<4;
		//PIOA->PIO_CODR = 0b1111111111<<16;
		//PIOA->PIO_SODR = (205+( 298 * C           + 409 * E + 128))<<16;
		//PIOB->PIO_CODR = 15<<4;
		//PIOB->PIO_SODR = 1<<4;
		//PIOA->PIO_CODR = 0b1111111111<<16;
		//PIOA->PIO_SODR = (205+( 298 * C - 100 * D - 208 * E + 128))<<16;
		//PIOB->PIO_CODR = 15<<4;
		//PIOB->PIO_SODR = 1<<4;
		//PIOA->PIO_CODR = 0b1111111111<<16;
		//PIOA->PIO_SODR = (205+( 298 * C + 516 * D           + 128))<<16;
		//PIOA->PIO_CODR = 0b1111111111<<16;
		//PIOB->PIO_CODR = 15;
		//PIOB->PIO_SODR = 1;
		//C = video_H[indexes[num][incr++]] - 16;
		//D = video_H[indexes[num][incr++]] - 128;
		//E = video_H[indexes[num][incr++]] - 128;
		//PIOB->PIO_CODR = 15<<4;
		//PIOB->PIO_SODR = 1<<4;
		//PIOA->PIO_CODR = 0b1111111111<<16;
		//PIOA->PIO_SODR = (205+( 298 * C           + 409 * E + 128))<<16;
		//PIOB->PIO_CODR = 15<<4;
		//PIOB->PIO_SODR = 1<<4;
		//PIOA->PIO_CODR = 0b1111111111<<16;
		//PIOA->PIO_SODR = (205+( 298 * C - 100 * D - 208 * E + 128))<<16;
		//PIOB->PIO_CODR = 15<<4;
		//PIOB->PIO_SODR = 1<<4;
		//PIOA->PIO_CODR = 0b1111111111<<16;
		//PIOA->PIO_SODR = (205+( 298 * C + 516 * D           + 128))<<16;
		//PIOA->PIO_CODR = 0b1111111111<<16;
		//PIOB->PIO_CODR = 15;
		//PIOB->PIO_SODR = 1;
		//C = video_H[indexes[num][incr++]] - 16;
		//D = video_H[indexes[num][incr++]] - 128;
		//E = video_H[indexes[num][incr++]] - 128;
		//PIOB->PIO_CODR = 15<<4;
		//PIOB->PIO_SODR = 1<<4;
		//PIOA->PIO_CODR = 0b1111111111<<16;
		//PIOA->PIO_SODR = (205+( 298 * C           + 409 * E + 128))<<16;
		//PIOB->PIO_CODR = 15<<4;
		//PIOB->PIO_SODR = 1<<4;
		//PIOA->PIO_CODR = 0b1111111111<<16;
		//PIOA->PIO_SODR = (205+( 298 * C - 100 * D - 208 * E + 128))<<16;
		//PIOB->PIO_CODR = 15<<4;
		//PIOB->PIO_SODR = 1<<4;
		//PIOA->PIO_CODR = 0b1111111111<<16;
		//PIOA->PIO_SODR = (205+( 298 * C + 516 * D           + 128))<<16;
		//PIOA->PIO_CODR = 0b1111111111<<16;
		//
		//PIOB->PIO_CODR = 15;
		//PIOB->PIO_SODR = 1;
		//C = video_H[indexes[num][incr++]] - 16;
		//D = video_H[indexes[num][incr++]] - 128;
		//E = video_H[indexes[num][incr++]] - 128;
		//PIOB->PIO_CODR = 15<<4;
		//PIOB->PIO_SODR = 1<<4;
		//PIOA->PIO_CODR = 0b1111111111<<16;
		//PIOA->PIO_SODR = (205+( 298 * C           + 409 * E + 128))<<16;
		//PIOB->PIO_CODR = 15<<4;
		//PIOB->PIO_SODR = 1<<4;
		//PIOA->PIO_CODR = 0b1111111111<<16;
		//PIOA->PIO_SODR = (205+( 298 * C - 100 * D - 208 * E + 128))<<16;
		//PIOB->PIO_CODR = 15<<4;
		//PIOB->PIO_SODR = 1<<4;
		//PIOA->PIO_CODR = 0b1111111111<<16;
		//PIOA->PIO_SODR = (205+( 298 * C + 516 * D           + 128))<<16;
		//PIOA->PIO_CODR = 0b1111111111<<16;
		//PIOB->PIO_CODR = 15;
		//PIOB->PIO_SODR = 1;
		//C = video_H[indexes[num][incr++]] - 16;
		//D = video_H[indexes[num][incr++]] - 128;
		//E = video_H[indexes[num][incr++]] - 128;
		//PIOB->PIO_CODR = 15<<4;
		//PIOB->PIO_SODR = 1<<4;
		//PIOA->PIO_CODR = 0b1111111111<<16;
		//PIOA->PIO_SODR = (205+( 298 * C           + 409 * E + 128))<<16;
		//PIOB->PIO_CODR = 15<<4;
		//PIOB->PIO_SODR = 1<<4;
		//PIOA->PIO_CODR = 0b1111111111<<16;
		//PIOA->PIO_SODR = (205+( 298 * C - 100 * D - 208 * E + 128))<<16;
		//PIOB->PIO_CODR = 15<<4;
		//PIOB->PIO_SODR = 1<<4;
		//PIOA->PIO_CODR = 0b1111111111<<16;
		//PIOA->PIO_SODR = (205+( 298 * C + 516 * D           + 128))<<16;
		//PIOA->PIO_CODR = 0b1111111111<<16;
		//PIOB->PIO_CODR = 15;
		//PIOB->PIO_SODR = 1;
		//C = video_H[indexes[num][incr++]] - 16;
		//D = video_H[indexes[num][incr++]] - 128;
		//E = video_H[indexes[num][incr++]] - 128;
		//PIOB->PIO_CODR = 15<<4;
		//PIOB->PIO_SODR = 1<<4;
		//PIOA->PIO_CODR = 0b1111111111<<16;
		//PIOA->PIO_SODR = (205+( 298 * C           + 409 * E + 128))<<16;
		//PIOB->PIO_CODR = 15<<4;
		//PIOB->PIO_SODR = 1<<4;
		//PIOA->PIO_CODR = 0b1111111111<<16;
		//PIOA->PIO_SODR = (205+( 298 * C - 100 * D - 208 * E + 128))<<16;
		//PIOB->PIO_CODR = 15<<4;
		//PIOB->PIO_SODR = 1<<4;
		//PIOA->PIO_CODR = 0b1111111111<<16;
		//PIOA->PIO_SODR = (205+( 298 * C + 516 * D           + 128))<<16;
		//PIOA->PIO_CODR = 0b1111111111<<16;
		//PIOB->PIO_CODR = 15;
		//PIOB->PIO_SODR = 1;
		//C = video_H[indexes[num][incr++]] - 16;
		//D = video_H[indexes[num][incr++]] - 128;
		//E = video_H[indexes[num][incr++]] - 128;
		//PIOB->PIO_CODR = 15<<4;
		//PIOB->PIO_SODR = 1<<4;
		//PIOA->PIO_CODR = 0b1111111111<<16;
		//PIOA->PIO_SODR = (205+( 298 * C           + 409 * E + 128))<<16;
		//PIOB->PIO_CODR = 15<<4;
		//PIOB->PIO_SODR = 1<<4;
		//PIOA->PIO_CODR = 0b1111111111<<16;
		//PIOA->PIO_SODR = (205+( 298 * C - 100 * D - 208 * E + 128))<<16;
		//PIOB->PIO_CODR = 15<<4;
		//PIOB->PIO_SODR = 1<<4;
		//PIOA->PIO_CODR = 0b1111111111<<16;
		//PIOA->PIO_SODR = (205+( 298 * C + 516 * D           + 128))<<16;
		//PIOA->PIO_CODR = 0b1111111111<<16;
		//PIOB->PIO_CODR = 15;
		//PIOB->PIO_SODR = 1;
		//C = video_H[indexes[num][incr++]] - 16;
		//D = video_H[indexes[num][incr++]] - 128;
		//E = video_H[indexes[num][incr++]] - 128;
		//PIOB->PIO_CODR = 15<<4;
		//PIOB->PIO_SODR = 1<<4;
		//PIOA->PIO_CODR = 0b1111111111<<16;
		//PIOA->PIO_SODR = (205+( 298 * C           + 409 * E + 128))<<16;
		//PIOB->PIO_CODR = 15<<4;
		//PIOB->PIO_SODR = 1<<4;
		//PIOA->PIO_CODR = 0b1111111111<<16;
		//PIOA->PIO_SODR = (205+( 298 * C - 100 * D - 208 * E + 128))<<16;
		//PIOB->PIO_CODR = 15<<4;
		//PIOB->PIO_SODR = 1<<4;
		//PIOA->PIO_CODR = 0b1111111111<<16;
		//PIOA->PIO_SODR = (205+( 298 * C + 516 * D           + 128))<<16;
		//PIOA->PIO_CODR = 0b1111111111<<16;
		//
		//PIOB->PIO_CODR = 15;
		//PIOB->PIO_SODR = 1;
		//C = video_H[indexes[num][incr++]] - 16;
		//D = video_H[indexes[num][incr++]] - 128;
		//E = video_H[indexes[num][incr++]] - 128;
		//PIOB->PIO_CODR = 15<<4;
		//PIOB->PIO_SODR = 1<<4;
		//PIOA->PIO_CODR = 0b1111111111<<16;
		//PIOA->PIO_SODR = (205+( 298 * C           + 409 * E + 128))<<16;
		//PIOB->PIO_CODR = 15<<4;
		//PIOB->PIO_SODR = 1<<4;
		//PIOA->PIO_CODR = 0b1111111111<<16;
		//PIOA->PIO_SODR = (205+( 298 * C - 100 * D - 208 * E + 128))<<16;
		//PIOB->PIO_CODR = 15<<4;
		//PIOB->PIO_SODR = 1<<4;
		//PIOA->PIO_CODR = 0b1111111111<<16;
		//PIOA->PIO_SODR = (205+( 298 * C + 516 * D           + 128))<<16;
		//PIOA->PIO_CODR = 0b1111111111<<16;
		//PIOB->PIO_CODR = 15;
		//PIOB->PIO_SODR = 1;
		//C = video_H[indexes[num][incr++]] - 16;
		//D = video_H[indexes[num][incr++]] - 128;
		//E = video_H[indexes[num][incr++]] - 128;
		//PIOB->PIO_CODR = 15<<4;
		//PIOB->PIO_SODR = 1<<4;
		//PIOA->PIO_CODR = 0b1111111111<<16;
		//PIOA->PIO_SODR = (205+( 298 * C           + 409 * E + 128))<<16;
		//PIOB->PIO_CODR = 15<<4;
		//PIOB->PIO_SODR = 1<<4;
		//PIOA->PIO_CODR = 0b1111111111<<16;
		//PIOA->PIO_SODR = (205+( 298 * C - 100 * D - 208 * E + 128))<<16;
		//PIOB->PIO_CODR = 15<<4;
		//PIOB->PIO_SODR = 1<<4;
		//PIOA->PIO_CODR = 0b1111111111<<16;
		//PIOA->PIO_SODR = (205+( 298 * C + 516 * D           + 128))<<16;
		//PIOA->PIO_CODR = 0b1111111111<<16;
		//PIOB->PIO_CODR = 15;
		//PIOB->PIO_SODR = 1;
		//C = video_H[indexes[num][incr++]] - 16;
		//D = video_H[indexes[num][incr++]] - 128;
		//E = video_H[indexes[num][incr++]] - 128;
		//PIOB->PIO_CODR = 15<<4;
		//PIOB->PIO_SODR = 1<<4;
		//PIOA->PIO_CODR = 0b1111111111<<16;
		//PIOA->PIO_SODR = (205+( 298 * C           + 409 * E + 128))<<16;
		//PIOB->PIO_CODR = 15<<4;
		//PIOB->PIO_SODR = 1<<4;
		//PIOA->PIO_CODR = 0b1111111111<<16;
		//PIOA->PIO_SODR = (205+( 298 * C - 100 * D - 208 * E + 128))<<16;
		//PIOB->PIO_CODR = 15<<4;
		//PIOB->PIO_SODR = 1<<4;
		//PIOA->PIO_CODR = 0b1111111111<<16;
		//PIOA->PIO_SODR = (205+( 298 * C + 516 * D           + 128))<<16;
		//PIOA->PIO_CODR = 0b1111111111<<16;
		//PIOB->PIO_CODR = 15;
		//PIOB->PIO_SODR = 1;
		//C = video_H[indexes[num][incr++]] - 16;
		//D = video_H[indexes[num][incr++]] - 128;
		//E = video_H[indexes[num][incr++]] - 128;
		//PIOB->PIO_CODR = 15<<4;
		//PIOB->PIO_SODR = 1<<4;
		//PIOA->PIO_CODR = 0b1111111111<<16;
		//PIOA->PIO_SODR = (205+( 298 * C           + 409 * E + 128))<<16;
		//PIOB->PIO_CODR = 15<<4;
		//PIOB->PIO_SODR = 1<<4;
		//PIOA->PIO_CODR = 0b1111111111<<16;
		//PIOA->PIO_SODR = (205+( 298 * C - 100 * D - 208 * E + 128))<<16;
		//PIOB->PIO_CODR = 15<<4;
		//PIOB->PIO_SODR = 1<<4;
		//PIOA->PIO_CODR = 0b1111111111<<16;
		//PIOA->PIO_SODR = (205+( 298 * C + 516 * D           + 128))<<16;
		//PIOA->PIO_CODR = 0b1111111111<<16;
		//PIOB->PIO_CODR = 15;
		//PIOB->PIO_SODR = 1;
		//C = video_H[indexes[num][incr++]] - 16;
		//D = video_H[indexes[num][incr++]] - 128;
		//E = video_H[indexes[num][incr++]] - 128;
		//PIOB->PIO_CODR = 15<<4;
		//PIOB->PIO_SODR = 1<<4;
		//PIOA->PIO_CODR = 0b1111111111<<16;
		//PIOA->PIO_SODR = (205+( 298 * C           + 409 * E + 128))<<16;
		//PIOB->PIO_CODR = 15<<4;
		//PIOB->PIO_SODR = 1<<4;
		//PIOA->PIO_CODR = 0b1111111111<<16;
		//PIOA->PIO_SODR = (205+( 298 * C - 100 * D - 208 * E + 128))<<16;
		//PIOB->PIO_CODR = 15<<4;
		//PIOB->PIO_SODR = 1<<4;
		//PIOA->PIO_CODR = 0b1111111111<<16;
		//PIOA->PIO_SODR = (205+( 298 * C + 516 * D           + 128))<<16;
		//PIOA->PIO_CODR = 0b1111111111<<16;
		//
		//PIOB->PIO_CODR = 15;
		//PIOB->PIO_SODR = 1;
		//C = video_H[indexes[num][incr++]] - 16;
		//D = video_H[indexes[num][incr++]] - 128;
		//E = video_H[indexes[num][incr++]] - 128;
		//PIOB->PIO_CODR = 15<<4;
		//PIOB->PIO_SODR = 1<<4;
		//PIOA->PIO_CODR = 0b1111111111<<16;
		//PIOA->PIO_SODR = (205+( 298 * C           + 409 * E + 128))<<16;
		//PIOB->PIO_CODR = 15<<4;
		//PIOB->PIO_SODR = 1<<4;
		//PIOA->PIO_CODR = 0b1111111111<<16;
		//PIOA->PIO_SODR = (205+( 298 * C - 100 * D - 208 * E + 128))<<16;
		//PIOB->PIO_CODR = 15<<4;
		//PIOB->PIO_SODR = 1<<4;
		//PIOA->PIO_CODR = 0b1111111111<<16;
		//PIOA->PIO_SODR = (205+( 298 * C + 516 * D           + 128))<<16;
		//PIOA->PIO_CODR = 0b1111111111<<16;
		//PIOB->PIO_CODR = 15;
		//PIOB->PIO_SODR = 1;
		//C = video_H[indexes[num][incr++]] - 16;
		//D = video_H[indexes[num][incr++]] - 128;
		//E = video_H[indexes[num][incr++]] - 128;
		//PIOB->PIO_CODR = 15<<4;
		//PIOB->PIO_SODR = 1<<4;
		//PIOA->PIO_CODR = 0b1111111111<<16;
		//PIOA->PIO_SODR = (205+( 298 * C           + 409 * E + 128))<<16;
		//PIOB->PIO_CODR = 15<<4;
		//PIOB->PIO_SODR = 1<<4;
		//PIOA->PIO_CODR = 0b1111111111<<16;
		//PIOA->PIO_SODR = (205+( 298 * C - 100 * D - 208 * E + 128))<<16;
		//PIOB->PIO_CODR = 15<<4;
		//PIOB->PIO_SODR = 1<<4;
		//PIOA->PIO_CODR = 0b1111111111<<16;
		//PIOA->PIO_SODR = (205+( 298 * C + 516 * D           + 128))<<16;
		//PIOA->PIO_CODR = 0b1111111111<<16;
		//PIOB->PIO_CODR = 15;
		//PIOB->PIO_SODR = 1;
		//C = video_H[indexes[num][incr++]] - 16;
		//D = video_H[indexes[num][incr++]] - 128;
		//E = video_H[indexes[num][incr++]] - 128;
		//PIOB->PIO_CODR = 15<<4;
		//PIOB->PIO_SODR = 1<<4;
		//PIOA->PIO_CODR = 0b1111111111<<16;
		//PIOA->PIO_SODR = (205+( 298 * C           + 409 * E + 128))<<16;
		//PIOB->PIO_CODR = 15<<4;
		//PIOB->PIO_SODR = 1<<4;
		//PIOA->PIO_CODR = 0b1111111111<<16;
		//PIOA->PIO_SODR = (205+( 298 * C - 100 * D - 208 * E + 128))<<16;
		//PIOB->PIO_CODR = 15<<4;
		//PIOB->PIO_SODR = 1<<4;
		//PIOA->PIO_CODR = 0b1111111111<<16;
		//PIOA->PIO_SODR = (205+( 298 * C + 516 * D           + 128))<<16;
		//PIOA->PIO_CODR = 0b1111111111<<16;
		//PIOB->PIO_CODR = 15;
		//PIOB->PIO_SODR = 1;
		//C = video_H[indexes[num][incr++]] - 16;
		//D = video_H[indexes[num][incr++]] - 128;
		//E = video_H[indexes[num][incr++]] - 128;
		//PIOB->PIO_CODR = 15<<4;
		//PIOB->PIO_SODR = 1<<4;
		//PIOA->PIO_CODR = 0b1111111111<<16;
		//PIOA->PIO_SODR = (205+( 298 * C           + 409 * E + 128))<<16;
		//PIOB->PIO_CODR = 15<<4;
		//PIOB->PIO_SODR = 1<<4;
		//PIOA->PIO_CODR = 0b1111111111<<16;
		//PIOA->PIO_SODR = (205+( 298 * C - 100 * D - 208 * E + 128))<<16;
		//PIOB->PIO_CODR = 15<<4;
		//PIOB->PIO_SODR = 1<<4;
		//PIOA->PIO_CODR = 0b1111111111<<16;
		//PIOA->PIO_SODR = (205+( 298 * C + 516 * D           + 128))<<16;
		//PIOA->PIO_CODR = 0b1111111111<<16;
		//PIOB->PIO_CODR = 15;
		//PIOB->PIO_SODR = 1;
		//C = video_H[indexes[num][incr++]] - 16;
		//D = video_H[indexes[num][incr++]] - 128;
		//E = video_H[indexes[num][incr++]] - 128;
		//PIOB->PIO_CODR = 15<<4;
		//PIOB->PIO_SODR = 1<<4;
		//PIOA->PIO_CODR = 0b1111111111<<16;
		//PIOA->PIO_SODR = (205+( 298 * C           + 409 * E + 128))<<16;
		//PIOB->PIO_CODR = 15<<4;
		//PIOB->PIO_SODR = 1<<4;
		//PIOA->PIO_CODR = 0b1111111111<<16;
		//PIOA->PIO_SODR = (205+( 298 * C - 100 * D - 208 * E + 128))<<16;
		//PIOB->PIO_CODR = 15<<4;
		//PIOB->PIO_SODR = 1<<4;
		//PIOA->PIO_CODR = 0b1111111111<<16;
		//PIOA->PIO_SODR = (205+( 298 * C + 516 * D           + 128))<<16;
		//PIOA->PIO_CODR = 0b1111111111<<16;
		//
		
			
			
    }
	
}

void TC0_Handler(void){
		(void)(tc_channel->TC_SR);
		
		c = !c;
		
		if(!c){
			base->PIO_CODR = mask;
		}
		else{
			base->PIO_SODR = mask;
		}
}

void UART0_Handler(void)
{
	if ((UART0->UART_SR & UART_SR_RXBUFF) == UART_SR_RXBUFF) {
		for(int i = 0; i < 200; ++i){
			while (!(UART0->UART_SR & UART_SR_TXRDY));
			UART0->UART_THR = buffer[i];
		}
		PDC_UART0->PERIPH_RPR = (uint32_t)buffer;
		PDC_UART0->PERIPH_RCR = 200;
	}
}

void USART0_Handler(void)
{
	if ((USART0->US_CSR & US_CSR_TXBUFE) == US_CSR_TXBUFE) {
		PDC_USART0->PERIPH_TPR = (uint32_t)buffer_usart;
		PDC_USART0->PERIPH_TCR = 20;
	}
}
